/*==========================================================================
	ID读卡器
	1.串口4初始化,ID卡接口,获取卡号,9600,8+n+1
	2.用定时器5作为串口接收一帧数据的5ms超时定时
	2016.1.23	Li
==========================================================================*/
#include "id.h"
#include "usart.h"

/***************************************************
	函数名称：void ID_Init( void )
	功		能：ID读卡器接口初始化,9600,8+n+1
	入		参：无
	返		回：无
***************************************************/
void ID_Init( void )
{
	uart4_init(36,9600);
}
/****************************************************
	串口4初始化函数
	pclk1:PCLK1时钟频率(Mhz); 最高36MHz
	bound:波特率
****************************************************/
void uart4_init(u32 pclk1,u32 bound)
{
	float temp;
	u16 mantissa;
	u16 fraction;	   
	temp=(float)(pclk1*1000000)/(bound*16);	//得到USARTDIV
	mantissa=temp;				 									//得到整数部分
	fraction=(temp-mantissa)*16; 						//得到小数部分	 
  mantissa<<=4;
	mantissa+=fraction;
	
	RCC->APB2ENR|=1<<4;   	//使能PORTC口时钟
	RCC->APB1ENR|=1<<19;  	//使能串口4时钟 
	GPIOC->CRH&=0XFFFF00FF;	//IO状态设置
	GPIOC->CRH|=0X00008B00;	//IO状态设置

	RCC->APB1RSTR|=1<<19;   //复位串口4
	RCC->APB1RSTR&=~(1<<19);//停止复位
	//波特率设置
 	UART4->BRR=mantissa; 		// 波特率设置	 
	UART4->CR1|=0X000C;  		//1位停止,无校验位.
	//使能接收中断
	UART4->CR1|=1<<8;    		//PE中断使能
	UART4->CR1|=1<<5;    		//接收缓冲区非空中断使能
	MY_NVIC_Init(0,3,UART4_IRQn,2);//组2,抢占优先级0,响应优先级3(和串口5有相同的中断优先级)
}
/****************************************************
	串口4使能
****************************************************/
void USART4_En( void )
{
	UART4->CR1|=0X2000;  //USART4 使能
}
/****************************************************
	串口4发送函数
****************************************************/
// 发送一个字节数据
void USART4_SendByte(u8 data)
{
	UART4->DR=data;
	while((UART4->SR&0x0080) == 0x00);//等待发送数据寄存器为空
}
// 发送Length长的字节数据
void USART4_Send(u8 *Pdata, u8 Length)
{
	u8 temp;
	for(temp=0;temp<Length;temp++)
	{
		USART4_SendByte(Pdata[temp]);	
	}	
}
/****************************************************
	串口4接收中断
****************************************************/
u8  USART4_RX_BUF[20]; //接收缓冲,最大USART2_REC_LEN个字节.
u8	USART4_RX_STA=0; //接收状态标记
										 //接收状态
										 //bit15，	接收完成标志
										 //bit14，	接收到0x0d
										 //bit13~0，接收到的有效字节数目
unsigned char	IDNumReceiveStatus=0;//接收状态标志(NULL:未接受到；OK:接收正确；ERROR:接收错误),需手动清零
// struct IDNUM 	ID;		 	//维根码(低26bit有效)
unsigned char ID = 0;			//ID卡号,0-255
void UART4_IRQHandler(void)
{
	u8 res;
	if(UART4->SR&(1<<5))//接收到数据
	{	 
		res=UART4->DR;
		USART4_RX_BUF[USART4_RX_STA++]=res;
// 		USART3_SendByte(res);
// 		TIM6_IRQSource=ID_TRIG;//设置timer 5的中断源标志位为LINE9 上的外部中断触发
		TIM6_Dis();				//关定时器中断
		TIM6_ClrCont();		//清计数器值
		TIM6_En();				//开定时器中断
	}
}
//===========================================================================================================================//
//																					End Of File																																			 //
//===========================================================================================================================//
