/*==========================================================================
	HMI 串口1初始化
	1.HMI设备采用232串口通讯
	2.USART1、19200、8+n+1
	2016.2.23	Li
==========================================================================*/
#include "hmi.h"

/***************************************************
	函数名称：void HMI_Init( void )
	功		能：HMI接口初始化,19200,8+n+1
	入		参：无
	返		回：无
***************************************************/
void HMI_Init( void )
{
	uart1_init(72,19200); 			//设置串口 1 波特率
}
/****************************************************
	串口1初始化函数
	pclk2:PCLK2时钟频率(Mhz)
	bound:波特率
****************************************************/
void uart1_init(u32 pclk2,u32 bound)
{  	 
	float temp;
	u16 mantissa;
	u16 fraction;	   
	temp=(float)(pclk2*1000000)/(bound*16);//得到USARTDIV
	mantissa=temp;				 //得到整数部分
	fraction=(temp-mantissa)*16; //得到小数部分	 
  mantissa<<=4;
	mantissa+=fraction;
	
	RCC->APB2ENR|=1<<2;   //使能PORTA口时钟  
	RCC->APB2ENR|=1<<14;  //使能串口1时钟 
	GPIOA->CRH&=0XFFFFF00F;//IO状态设置
	GPIOA->CRH|=0X000008B0;//IO状态设置

	RCC->APB2RSTR|=1<<14;   //复位串口1
	RCC->APB2RSTR&=~(1<<14);//停止复位	   	   
	//波特率设置
 	USART1->BRR=mantissa; // 波特率设置	 
	USART1->CR1|=0X000C;  //1位停止,无校验位.
	//使能接收中断
	USART1->CR1|=1<<8;    //PE中断使能
	USART1->CR1|=1<<5;    //接收缓冲区非空中断使能
	MY_NVIC_Init(1,3,USART1_IRQn,2);//组2,抢占优先级1,响应优先级3
}
/****************************************************
	串口1使能
****************************************************/
void USART1_En( void )
{
	USART1->CR1|=0X2000;  //USART 使能
}
/****************************************************
	串口1发送函数
****************************************************/
// 发送一个字节数据
void USART1_SendByte(u8 data)
{
	USART1->DR=data;
	while((USART1->SR&0x0080) == 0x00);//等待发送数据寄存器为空
}
// 发送Length长的字节数据
void USART1_Send(u8 *Pdata, u8 Length)
{
	u8 temp;
	for(temp=0;temp<Length;temp++)
	{
		USART1_SendByte(Pdata[temp]);
	}
}
/****************************************************
	串口1接收中断
****************************************************/
u8  USART1_RX_BUF[RX_BUF_LEN]; //接收缓冲,最大20个字节.
u8  USART1_TX_BUF[TX_BUF_LEN]; //发送缓冲
u8  USART1_RX_STA=0;//接收状态标记
										//bit7，		接收完成
										//bit6~0，	接收到的有效字节数目
void USART1_IRQHandler(void)
{
	u8 res;
	if(USART1->SR&(1<<5))//接收到数据
	{
		res=USART1->DR;
		USART1_RX_BUF[USART1_RX_STA++]=res;
		
		TIM2_IRQSource=HMI_TRIG;	//设置timer 5的中断源标志位为HMI串口1触发
		TIM2_Dis();				//关定时器中断
		TIM2_ClrCont();		//清计数器值
		TIM2_En();				//开定时器中断
	}
}
//===========================================================================================================================//
//																					End Of File																																			 //
//===========================================================================================================================//
